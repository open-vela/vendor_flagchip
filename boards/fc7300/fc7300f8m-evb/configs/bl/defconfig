## boards/fc7300/fc7300f8m-evb/configs/kcore0/defconfig
```kconfig
#include "../core0/defconfig"

# CONFIG_SIG_EVTHREAD is not set
CONFIG_ARCH_ADDRENV=y
CONFIG_ARCH_KSTACK_PROTECT=y
CONFIG_ARCH_STACK_PROTECT=y
CONFIG_BUILD_PROTECTED=y
CONFIG_KFLASH_A_BANK0_SIZE=1536
CONFIG_MM_KERNEL_HEAP=y
CONFIG_NUTTX_USERSPACE=0x011C0000
CONFIG_PASS1_BUILDIR="../vendor/flagchip/boards/fc7300/fc7300f8m-evb/kernel"
CONFIG_RAM_SIZE=249856
CONFIG_RAM_START=0x21023000
CONFIG_RAW_BINARY=y
CONFIG_STACK_ALIGN_SIZE=512
```
